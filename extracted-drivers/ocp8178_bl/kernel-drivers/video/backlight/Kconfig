## extracted-drivers/ocp8178_bl/kernel-drivers/video/backlight/Kconfig
```kconfig
config BACKLIGHT_OCP8178
	tristate "OCP8178 Backlight Driver"
	depends on GPIOLIB
	help
	  If you have an OCP8178, say Y to enable the backlight driver.
 
```

## extracted-drivers/panel-cwu50-cm3/kernel-drivers/gpu/drm/panel/Kconfig
```kconfig
config DRM_PANEL_CWD686
	tristate "CWD686 panel"
 	depends on OF
	depends on DRM_MIPI_DSI
	depends on BACKLIGHT_CLASS_DEVICE
	help
	  Say Y here if you want to enable support for CWD686 panel.
	  The panel has a 480x1280 resolution and uses 24 bit RGB per pixel.
	  To compile this driver as a module, choose M here: the module
	  will be called panel-cwd686.

config DRM_PANEL_CWU50
	tristate "CWU50 panel"
 	depends on OF
	depends on DRM_MIPI_DSI
	depends on BACKLIGHT_CLASS_DEVICE
	help
	  Say Y here if you want to enable support for CWU50 panel.
	  The panel has a 720x1280 resolution and uses 24 bit RGB per pixel.
	  To compile this driver as a module, choose M here: the module
	  will be called panel-cwu50.

config DRM_PANEL_CWU50_CM3
	tristate "CWU50_CM3 panel"
 	depends on OF
	depends on DRM_MIPI_DSI
	depends on BACKLIGHT_CLASS_DEVICE
	help
	  Say Y here if you want to enable support for CWU50_CM3 panel.
	  The panel has a 720x1280 resolution and uses 24 bit RGB per pixel.
	  To compile this driver as a module, choose M here: the module
	  will be called panel-cwu50-cm3.
```
